## Kconfig
```kconfig
menu "ESP File System journaling"

    config ESP_JRNL_ENABLE_TESTMODE
        bool "Enable built-in test configurations"
        default n
        help
            Enable deplopyment of built-in test configuration for test_apps

    config ESP_JRNL_DEBUG_PRINT
        bool "Enable debug printouts"
        default n
        help
            Enable debug printouts. Useful for 'jrnl_master' contents check

endmenu # esp_jrnl
```

## test_apps/jrnl_adv/sdkconfig.defaults
```kconfig
# use custom partition table
CONFIG_PARTITION_TABLE_CUSTOM=y
CONFIG_PARTITION_TABLE_CUSTOM_FILENAME="partitions.csv"
CONFIG_ESPTOOLPY_FLASHSIZE="4MB"
CONFIG_ESPTOOLPY_FLASHSIZE_4MB=y

#use Unity fixtures
CONFIG_UNITY_ENABLE_FIXTURE=y

#enable ESP FS journal test mode
CONFIG_ESP_JRNL_ENABLE_TESTMODE=y
CONFIG_ESP_JRNL_DEBUG_PRINT=n

#no WDT reset
CONFIG_ESP_TASK_WDT_INIT=n
```
